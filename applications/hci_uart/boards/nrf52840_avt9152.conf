## applications/hci_uart/boards/nrf52840_avt9152.conf
```kconfig
# Override prj.conf defaults
CONFIG_CONSOLE=y
CONFIG_STDOUT_CONSOLE=y
CONFIG_UART_CONSOLE=y

#CONFIG_LOG=y

CONFIG_GPIO=y
CONFIG_MAIN_STACK_SIZE=1024
CONFIG_SYSTEM_WORKQUEUE_STACK_SIZE=512
CONFIG_BT_WAIT_NOP=y
CONFIG_BT_MAX_CONN=16
CONFIG_BT_TINYCRYPT_ECC=n
CONFIG_BT_CTLR_DTM_HCI=y
CONFIG_BT_CTLR_ASSERT_HANDLER=y
CONFIG_BT_LL_SW_SPLIT=y

# for mcuboot serial recovery support
CONFIG_BOOTLOADER_MCUBOOT=y
```

## boards/arm/nrf52840_avt9152/Kconfig
```kconfig
# nRF52840 AVT9152 board configuration

# Copyright (c) 2016 Nordic Semiconductor ASA
# SPDX-License-I

if BOARD_NRF52840_AVT9152

config BOARD_ENABLE_DCDC
	bool "Enable DCDC mode"
	select SOC_DCDC_NRF52X
	default y
	depends on BOARD_NRF52840_AVT9152

module = BOARD_AVT9152EVB
module-str = Board Control
source "subsys/logging/Kconfig.template.log_config"

endif # BOARD_NRF52840_AVT9152
```

## boards/arm/nrf52840_avt9152/Kconfig.board
```kconfig
# nRF52840 AVT9152 board configuration

# Copyright (c) 2016 Nordic Semiconductor ASA
# SPDX-License-Identifier: Apache-2.0

config BOARD_NRF52840_AVT9152
	bool "NRF52840 AVT9152"
	depends on SOC_NRF52840_QIAA
```

## boards/arm/nrf52840_avt9152/Kconfig.defconfig
```kconfig
# nRF52840 PCA10056 board configuration

# Copyright (c) 2016 Nordic Semiconductor ASA
# SPDX-License-Identifier: Apache-2.0

if BOARD_NRF52840_AVT9152

config BOARD
	default "nrf52840_avt9152"

if USB

config USB_NRFX
	default y

config USB_DEVICE_STACK
	default y

endif # USB

config IEEE802154_NRF5
	default y
	depends on IEEE802154
	
config BT_CTLR
	default BT

endif # BOARD_NRF52840_AVT9152
```

## boards/arm/nrf9160_avt9152/Kconfig
```kconfig
# nRF9160 PCA10090 board configuration

# Copyright (c) 2018 Nordic Semiconductor ASA
# SPDX-License-Identifier: Apache-2.0

config BOARD_NRF52840_GPIO_RESET
	bool "Use nRF52840 GPIO reset pin"
	default y if BT_H4
	depends on BOARD_NRF9160_AVT9152 || BOARD_NRF9160_AVT9152NS
	help
	  Use a GPIO pin to reset the nRF52840 controller and let it wait until all
	  bytes traveling to the H4 device have been received and drained, thus
	  ensuring communication can begin correctly.
```

## boards/arm/nrf9160_avt9152/Kconfig.board
```kconfig
# nRF9160 PCA10090 board configuration

# Copyright (c) 2018 Nordic Semiconductor ASA
# SPDX-License-Identifier: Apache-2.0

if SOC_NRF9160_SICA

config BOARD_NRF9160_AVT9152
	bool "nRF9160 AVT9152"

config BOARD_NRF9160_AVT9152NS
	bool "nRF9160 AVT9152 non-secure"

endif # SOC_NRF9160_SICA
```
